## firmware/components/driver_io_pca9555/Kconfig
```kconfig
menu "Driver: PCA9555 I/O port expander"
	config DRIVER_PCA9555_ENABLE
		depends on DRIVER_I2C_ENABLE
		bool "Enable the PCA9555 driver"
		default n
	
	config I2C_ADDR_PCA9555
		depends on DRIVER_PCA9555_ENABLE
		int "PCA9555 I2C address"
		default 32

	config PIN_NUM_PCA9555_INT
		depends on DRIVER_PCA9555_ENABLE
		int "GPIO pin used for PCA9555 interrupt"
	
	config DRIVER_PCA9555_POLARITY_0
		depends on DRIVER_PCA9555_ENABLE
		int "Setting for polarity register of port 0"
		default 255
	
	config DRIVER_PCA9555_POLARITY_1
		depends on DRIVER_PCA9555_ENABLE
		int "Setting for polarity register of port 1"
		default 255
	
	choice
		prompt "Port 0 pin 0 mode"
		default DRIVER_PCA9555_IO0P0_USER
		depends on DRIVER_PCA9555_ENABLE
	config DRIVER_PCA9555_IO0P0_USER
		bool "Controlled by user"
	config DRIVER_PCA9555_IO0P0_INPUT
		bool "Input"
	config DRIVER_PCA9555_IO0P0_OUTPUT
		bool "Output"
	endchoice
	
	choice
		prompt "Port 0 pin 1 mode"
		default DRIVER_PCA9555_IO0P1_USER
		depends on DRIVER_PCA9555_ENABLE
	config DRIVER_PCA9555_IO0P1_USER
		bool "Controlled by user"
	config DRIVER_PCA9555_IO0P1_INPUT
		bool "Input"
	config DRIVER_PCA9555_IO0P1_OUTPUT
		bool "Output"
	endchoice
	
	choice
		prompt "Port 0 pin 2 mode"
		default DRIVER_PCA9555_IO0P2_USER
		depends on DRIVER_PCA9555_ENABLE
	config DRIVER_PCA9555_IO0P2_USER
		bool "Controlled by user"
	config DRIVER_PCA9555_IO0P2_INPUT
		bool "Input"
	config DRIVER_PCA9555_IO0P2_OUTPUT
		bool "Output"
	endchoice
	
	choice
		prompt "Port 0 pin 3 mode"
		default DRIVER_PCA9555_IO0P3_USER
		depends on DRIVER_PCA9555_ENABLE
	config DRIVER_PCA9555_IO0P3_USER
		bool "Controlled by user"
	config DRIVER_PCA9555_IO0P3_INPUT
		bool "Input"
	config DRIVER_PCA9555_IO0P3_OUTPUT
		bool "Output"
	endchoice
	
	choice
		prompt "Port 0 pin 4 mode"
		default DRIVER_PCA9555_IO0P4_USER
		depends on DRIVER_PCA9555_ENABLE
	config DRIVER_PCA9555_IO0P4_USER
		bool "Controlled by user"
	config DRIVER_PCA9555_IO0P4_INPUT
		bool "Input"
	config DRIVER_PCA9555_IO0P4_OUTPUT
		bool "Output"
	endchoice
	
	choice
		prompt "Port 0 pin 5 mode"
		default DRIVER_PCA9555_IO0P5_USER
		depends on DRIVER_PCA9555_ENABLE
	config DRIVER_PCA9555_IO0P5_USER
		bool "Controlled by user"
	config DRIVER_PCA9555_IO0P5_INPUT
		bool "Input"
	config DRIVER_PCA9555_IO0P5_OUTPUT
		bool "Output"
	endchoice
	
	choice
		prompt "Port 0 pin 6 mode"
		default DRIVER_PCA9555_IO0P6_USER
		depends on DRIVER_PCA9555_ENABLE
	config DRIVER_PCA9555_IO0P6_USER
		bool "Controlled by user"
	config DRIVER_PCA9555_IO0P6_INPUT
		bool "Input"
	config DRIVER_PCA9555_IO0P6_OUTPUT
		bool "Output"
	endchoice
	
	choice
		prompt "Port 0 pin 7 mode"
		default DRIVER_PCA9555_IO0P7_USER
		depends on DRIVER_PCA9555_ENABLE
	config DRIVER_PCA9555_IO0P7_USER
		bool "Controlled by user"
	config DRIVER_PCA9555_IO0P7_INPUT
		bool "Input"
	config DRIVER_PCA9555_IO0P7_OUTPUT
		bool "Output"
	endchoice
	
	choice
		prompt "Port 1 pin 0 mode"
		default DRIVER_PCA9555_IO1P0_USER
		depends on DRIVER_PCA9555_ENABLE
	config DRIVER_PCA9555_IO1P0_USER
		bool "Controlled by user"
	config DRIVER_PCA9555_IO1P0_INPUT
		bool "Input"
	config DRIVER_PCA9555_IO1P0_OUTPUT
		bool "Output"
	endchoice
	
	choice
		prompt "Port 1 pin 1 mode"
		default DRIVER_PCA9555_IO1P1_USER
		depends on DRIVER_PCA9555_ENABLE
	config DRIVER_PCA9555_IO1P1_USER
		bool "Controlled by user"
	config DRIVER_PCA9555_IO1P1_INPUT
		bool "Input"
	config DRIVER_PCA9555_IO1P1_OUTPUT
		bool "Output"
	endchoice
	
	choice
		prompt "Port 1 pin 2 mode"
		default DRIVER_PCA9555_IO1P2_USER
		depends on DRIVER_PCA9555_ENABLE
	config DRIVER_PCA9555_IO1P2_USER
		bool "Controlled by user"
	config DRIVER_PCA9555_IO1P2_INPUT
		bool "Input"
	config DRIVER_PCA9555_IO1P2_OUTPUT
		bool "Output"
	endchoice
	
	choice
		prompt "Port 1 pin 3 mode"
		default DRIVER_PCA9555_IO1P3_USER
		depends on DRIVER_PCA9555_ENABLE
	config DRIVER_PCA9555_IO1P3_USER
		bool "Controlled by user"
	config DRIVER_PCA9555_IO1P3_INPUT
		bool "Input"
	config DRIVER_PCA9555_IO1P3_OUTPUT
		bool "Output"
	endchoice
	
	choice
		prompt "Port 1 pin 4 mode"
		default DRIVER_PCA9555_IO1P4_USER
		depends on DRIVER_PCA9555_ENABLE
	config DRIVER_PCA9555_IO1P4_USER
		bool "Controlled by user"
	config DRIVER_PCA9555_IO1P4_INPUT
		bool "Input"
	config DRIVER_PCA9555_IO1P4_OUTPUT
		bool "Output"
	endchoice
	
	choice
		prompt "Port 1 pin 5 mode"
		default DRIVER_PCA9555_IO1P5_USER
		depends on DRIVER_PCA9555_ENABLE
	config DRIVER_PCA9555_IO1P5_USER
		bool "Controlled by user"
	config DRIVER_PCA9555_IO1P5_INPUT
		bool "Input"
	config DRIVER_PCA9555_IO1P5_OUTPUT
		bool "Output"
	endchoice
	
	choice
		prompt "Port 1 pin 6 mode"
		default DRIVER_PCA9555_IO1P6_USER
		depends on DRIVER_PCA9555_ENABLE
	config DRIVER_PCA9555_IO1P6_USER
		bool "Controlled by user"
	config DRIVER_PCA9555_IO1P6_INPUT
		bool "Input"
	config DRIVER_PCA9555_IO1P6_OUTPUT
		bool "Output"
	endchoice
	
	choice
		prompt "Port 1 pin 7 mode"
		default DRIVER_PCA9555_IO1P7_USER
		depends on DRIVER_PCA9555_ENABLE
	config DRIVER_PCA9555_IO1P7_USER
		bool "Controlled by user"
	config DRIVER_PCA9555_IO1P7_INPUT
		bool "Input"
	config DRIVER_PCA9555_IO1P7_OUTPUT
		bool "Output"
	endchoice
endmenu
```

## firmware/components/driver_io_touchbuttons/Kconfig
```kconfig
menu "Driver: ESP32-native touchbuttons"
	config DRIVER_IO_TOUCHBUTTONS_ENABLE
		bool "Enable the driver for native ESP32 touchbuttons"
		default n

	config TOUCH_WAKEUP_SOURCE
		depends on DRIVER_IO_TOUCHBUTTONS_ENABLE
		bool "Enable the wake-up from deepsleep on touch button press"
		default y

	config TOUCH0_ENABLE
		depends on DRIVER_IO_TOUCHBUTTONS_ENABLE
		bool "Enable the 1st touch button (GPIO 4)"
		default n

	config TOUCH1_ENABLE
		depends on DRIVER_IO_TOUCHBUTTONS_ENABLE
		bool "Enable the 2nd touch button (GPIO 0)"
		default n

	config TOUCH2_ENABLE
		depends on DRIVER_IO_TOUCHBUTTONS_ENABLE
		bool "Enable the 3rd touch button (GPIO 2)"
		default n

	config TOUCH3_ENABLE
		depends on DRIVER_IO_TOUCHBUTTONS_ENABLE
		bool "Enable the 4th touch button (GPIO 15)"
		default n

	config TOUCH4_ENABLE
		depends on DRIVER_IO_TOUCHBUTTONS_ENABLE
		bool "Enable the 5th touch button (GPIO 13)"
		default n

	config TOUCH5_ENABLE
		depends on DRIVER_IO_TOUCHBUTTONS_ENABLE
		bool "Enable the 6th touch button (GPIO 12)"
		default n

	config TOUCH6_ENABLE
		depends on DRIVER_IO_TOUCHBUTTONS_ENABLE
		bool "Enable the 7th touch button (GPIO 14)"
		default n

	config TOUCH7_ENABLE
		depends on DRIVER_IO_TOUCHBUTTONS_ENABLE
		bool "Enable the 8th touch button (GPIO 27)"
		default n

	config TOUCH8_ENABLE
		depends on DRIVER_IO_TOUCHBUTTONS_ENABLE
		bool "Enable the 9th touch button (GPIO 33)"
		default n

	config TOUCH9_ENABLE
		depends on DRIVER_IO_TOUCHBUTTONS_ENABLE
		bool "Enable the 10th touch button (GPIO 32)"
		default n
endmenu
```

## firmware/components/driver_led_apa102/Kconfig
```kconfig
menu "Driver: APA102 LEDs"
    config DRIVER_APA102_ENABLE
        depends on BUS_VSPI_ENABLE
        bool "Enable APA102 LED driver"
        default n

    config DRIVER_APA102_SPI_SPEED
        depends on DRIVER_APA102_ENABLE
        int "SPI clock speed"
        default 12000000
        range 100000 40000000
endmenu
```

## firmware/components/driver_led_neopixel/Kconfig
```kconfig
menu "Driver: Neopixel LED driver"
	config DRIVER_NEOPIXEL_ENABLE
		bool "Enable the neopixel LED driver"
		default n
	
	config NEOPIXEL_PIN
		depends on DRIVER_NEOPIXEL_ENABLE
		int "GPIO pin used for data output"
		
	config DRIVER_NEOPIXEL_USE_MPR121_PIN
		depends on DRIVER_NEOPIXEL_ENABLE && DRIVER_MPR121_ENABLE
		bool "Use a GPIO pin of the MPR121 to enable SD card power"
		default n
		help
			Turn on an output on a connected MPR121 I/O expander before mounting the SD card.
		
	config DRIVER_NEOPIXEL_MPR121_PIN
		depends on DRIVER_NEOPIXEL_ENABLE && DRIVER_MPR121_ENABLE && DRIVER_NEOPIXEL_USE_MPR121_PIN
		int "MPR121 pin number"
endmenu
```

## firmware/components/driver_mpu6050/Kconfig
```kconfig
menu "Driver: MPU6050 accelerometer"
	config DRIVER_MPU6050_ENABLE
		depends on BUS_I2C0_ENABLE || BUS_I2C1_ENABLE
		bool "Enable the MPU6050 driver"
		default n
	config I2C_ADDR_MPU6050
		depends on DRIVER_MPU6050_ENABLE
		int "I2C address"
		default 104
	config DRIVER_MPU6050_I2C_BUS
		depends on DRIVER_MPU6050_ENABLE
		int"MPU6050 I2C bus"
		default 0
		range 0 1
	config DRIVER_MPU6050_IGNORE_FAILED
		depends on DRIVER_MPU6050_ENABLE
		bool "Ignore initialisation failure"
		default n
endmenu
```

## firmware/components/driver_radio_lora/Kconfig
```kconfig
menu "Driver: LoRa radio"
	config DRIVER_LORA_ENABLE
		depends on DRIVER_VSPI_ENABLE
		bool "Enable the LoRa driver"
		default n
	
	config PIN_NUM_LORA_RST
		depends on DRIVER_LORA_ENABLE
		int "GPIO pin used for LoRa reset"
	
	config PIN_NUM_LORA_CS
		depends on DRIVER_LORA_ENABLE
		int "GPIO pin used for LoRa chip-select"
	
	config PIN_NUM_LORA_INT
		depends on DRIVER_LORA_ENABLE
		int "GPIO pin used for LoRa interrupt"
	
endmenu
```

## firmware/components/driver_sensor_am2320/Kconfig
```kconfig
menu "Driver: AM2320 I2C temp/hum sensor"
	config DRIVER_AM2320_ENABLE
		depends on DRIVER_I2C_ENABLE
		bool "Enable the AM2320 I2C driver (You will need to set the I2C clock to 100Khz)"
		default n		

	config DRIVER_AM2320_I2C_ADDRESS
		depends on DRIVER_AM2320_ENABLE
		hex "I2c address for the AM2320 sensor"
		default 0x5C
endmenu
```

## firmware/components/driver_sndmixer/Kconfig
```kconfig
menu "Driver: Audio"
	config DRIVER_SNDMIXER_ENABLE
		bool "Enable the audio driver"
		default n
endmenu
```

## firmware/components/driver_stdinout_hook/Kconfig
```kconfig
menu "Driver: Hook MicroPython stdout + stdin to C applications"
	config DRIVER_STDINOUT_HOOK_ENABLE
		bool "Enable the stdinout hook driver"
		default n
	
	config DRIVER_STDOUT_VFS_NAME
		depends on DRIVER_STDINOUT_HOOK_ENABLE
		string "Name of the VFS mount point to read stdout from"
		default "/dev/hooked_stdout"

	config DRIVER_STDIN_VFS_NAME
		depends on DRIVER_STDINOUT_HOOK_ENABLE
		string "Name of the VFS mount point to write stdin into"
		default "/dev/hooked_stdin"
endmenu
```

## firmware/components/particle_simulation/Kconfig
```kconfig
menu "HUB75 Particle simulation"
	config PARTICLE_SIMULATION_ENABLE
		bool "Enable the particle simulation, used for running particle simulation based on accelerometer"
		default n
	config PARTICLE_SIMULATION_WIDTH
		int "Width of the particle simulation"
		default 32
	config PARTICLE_SIMULATION_HEIGHT
		int "Height of the particle simulation"
		default 8
endmenu
```

## firmware/main/Kconfig
```kconfig
menu "Build configuration"
	menu "Firmware description"
	config INFO_FIRMWARE_NAME
		string "Code-name of the firmware"
		default "Bleeding edge"
	
	config INFO_FIRMWARE_BUILD
		int "Buildnumber of the firmware"
		default 0
		help
                Build number of the firmware
	endmenu
	
	menu "Hardware description"
	config INFO_HARDWARE_NAME
		string "Name of the device"
		default "Generic device"
		help
                A semantic name for your badge

	config INFO_HARDWARE_FOLDER
		string "MicroPython modules directory"
		default "generic"
		help
                The name of the directory in /python_modules to load into firmware image as static micropython modules.
	endmenu
endmenu

menu "WiFi & OTA update"
	config OTA_WEB_SERVER
		string "Hostname of server for OTA updates"
		default "www.sensorcloud.nl"

	config OTA_WEB_PORT
		string "Port of server for OTA updates"
		default "443"

	config OTA_WEB_PATH
		string "Path on the server for OTA updates"
		default "/firmware.bin"

	config WIFI_SSID
		string "Default WiFi ssid"
		default ""

	config WIFI_PASSWORD
		string "Default WiFi password, leave empty for unsecure network"
		default ""
endmenu
```

## firmware/main/Kconfig.projbuild
```kconfig
menu "Firmware & device configuration"
	menu "Firmware description"
	config INFO_FIRMWARE_NAME
		string "Code-name of the firmware"
		default "Bleeding edge"

	config INFO_FIRMWARE_BUILD
		int "Build number of the firmware"
		default 0
		help
                Build number of the firmware
	endmenu

	menu "Hardware description"
	config INFO_HARDWARE_NAME
		string "Name of the device"
		default "Generic device"
		help
                A semantic name for your badge

	config INFO_HARDWARE_FOLDER
		string "MicroPython modules directory"
		default "generic"
		help
                The name of the directory in /python_modules to load into firmware image as static micropython modules.

	config INFO_HARDWARE_WOEZEL_NAME
		string "Name of the badge on the app hatchery"
		default "generic"
	endmenu

	menu "OTA and app hatchery servers"
	config OTA_WEB_SERVER
		string "Hostname of server for OTA updates"
		default "www.sensorcloud.nl"

	config OTA_WEB_PORT
		string "Port of server for OTA updates"
		default "443"

	config OTA_WEB_PATH
		string "Path on the server for OTA updates"
		default "/firmware.bin"

	config WOEZEL_WEB_SERVER
		string "Hostname of server for app hatchery that contains user apps"
		default "www.sensorcloud.nl"
	endmenu

    menu "WiFi"
	config WIFI_SSID
		string "Default WiFi ssid"
		default ""

	config WIFI_PASSWORD
		string "Default WiFi password, leave empty for unsecure network"
		default ""
	endmenu
endmenu

menu "Drivers"
    source "../components/driver_*/Kconfig"
endmenu
```
