## firmware/components/driver_bus_i2c/Kconfig
```kconfig
menu "Driver: I2C bus"
	config DRIVER_I2C_ENABLE
		bool "Enable the I2C bus driver"
		default n
	
	config PIN_NUM_I2C_DATA
		depends on DRIVER_I2C_ENABLE
		int "GPIO to use as data pin"
	
	config PIN_NUM_I2C_CLK
		depends on DRIVER_I2C_ENABLE
		int "GPIO to use as clock pin"
	
	config PIN_PULL_I2C_DATA
		depends on DRIVER_I2C_ENABLE
		bool "Enable the built-in pull-up for the data pin (WARNING: If possible use real a real pull-up!)"
		default n
	
	config PIN_PULL_I2C_CLK
		depends on DRIVER_I2C_ENABLE
		bool "Enable the built-in pull-up for the clock pin (WARNING: If possible use real a real pull-up!)"
		default n
	
	config I2C_MASTER_FREQ_HZ
		depends on DRIVER_I2C_ENABLE
		int "I2C speed in Hz"
		default 100000
endmenu
```

## firmware/components/driver_bus_vspi/Kconfig
```kconfig
menu "Driver: VSPI bus"
	config DRIVER_VSPI_ENABLE
		bool "Enable the VSPI bus driver"
		default n
	
	config PIN_NUM_VSPI_CLK
		depends on DRIVER_VSPI_ENABLE
		int "GPIO pin used for CLK"
	
	config PIN_NUM_VSPI_MOSI
		depends on DRIVER_VSPI_ENABLE
		int "GPIO pin used for MOSI"
	
	config PIN_NUM_VSPI_MISO
		depends on DRIVER_VSPI_ENABLE
		int "GPIO pin used for MISO"
	
	config PIN_NUM_VSPI_WP
		depends on DRIVER_VSPI_ENABLE
		int "GPIO pin used for WP"
		default -1
	
	config PIN_NUM_VSPI_HD
		depends on DRIVER_VSPI_ENABLE
		int "GPIO pin used for HD"
		default -1
	
	config DRIVER_VSPI_DMA_CHANNEL
		depends on DRIVER_VSPI_ENABLE
		int "DMA channel"
		default 2
		range 0 2
	
	config DRIVER_VSPI_MAX_TRANSFERSIZE
		depends on DRIVER_VSPI_ENABLE
		int "Maximum transfer size (in bytes)"
		default 4094
endmenu
```

## firmware/components/driver_display_dotflipper/Kconfig
```kconfig
menu "Driver: Flipdot display (Sebastius)"
	config DRIVER_DOTFLIPPER_ENABLE
		depends on DRIVER_I2C_ENABLE
		bool "Enable the dotflipper driver"
		default n
	
	config DOTFLIPPER_WIDTH
		depends on DRIVER_DOTFLIPPER_ENABLE
		int "Number of panels horizontal"
	
	config DOTFLIPPER_HEIGHT
		depends on DRIVER_DOTFLIPPER_ENABLE
		int "Number of panels vertical"
	
endmenu
```

## firmware/components/driver_display_eink/Kconfig
```kconfig
menu "Driver: E-ink display"
	config DRIVER_EINK_ENABLE
		depends on DRIVER_VSPI_ENABLE
		bool "Enable the e-ink display driver"
		default n
	
	choice
		depends on DRIVER_VSPI_ENABLE
		prompt "E-ink default type"
		default DRIVER_EINK_TYPE_DEPG0290B1
	config DRIVER_EINK_TYPE_NONE
		bool "None"
	config DRIVER_EINK_TYPE_GDEH029A1
		bool "GDEH029A1"
	config DRIVER_EINK_TYPE_DEPG0290B1
		bool "DEPG0290B1"
	endchoice
	
	config EPD_ROTATED_180
		depends on DRIVER_EINK_ENABLE
		bool "Rotate the e-ink display by 180 degrees"
		default y
	
	config PIN_NUM_EPD_RESET
		depends on DRIVER_EINK_ENABLE
		int "GPIO pin used for e-ink reset"
		default 23
		
	config PIN_NUM_EPD_BUSY
		depends on DRIVER_EINK_ENABLE
		int "GPIO pin used for e-ink busy"
		default 22
	
	config PIN_NUM_EPD_CS
		depends on DRIVER_EINK_ENABLE
		int "GPIO pin used for e-ink CS"
		default 19
	
	config PIN_NUM_EPD_DATA
		depends on DRIVER_EINK_ENABLE
		int "GPIO pin used for e-ink DC"
		default 21
		
	config DRIVER_EINK_FORCE_1BPP
		depends on DRIVER_EINK_ENABLE
		bool "Force 1 bit-per-pixel mode for the framebuffer"
		default n
endmenu
```

## firmware/components/driver_display_erc12864/Kconfig
```kconfig
menu "Driver: ERC12864 LCD display"
	config DRIVER_ERC12864_ENABLE
		depends on DRIVER_I2C_ENABLE
		bool "Enable the ERC12864 display driver"
		default n
	
	config I2C_ADDR_ERC12864
		depends on DRIVER_ERC12864_ENABLE
		int "ERC12864 I2C address"
		default 56
	
	config ERC12864_FLIP
		depends on DRIVER_ERC12864_ENABLE
		bool "Flip display 180 degrees"
		default y
endmenu
```

## firmware/components/driver_display_flipdotter/Kconfig
```kconfig
menu "Driver: Flipdot display (Otter)"
	config DRIVER_FLIPDOTTER_ENABLE
		depends on DRIVER_VSPI_ENABLE
		bool "Enable the otter flipdot driver"
		default n
	
	config PIN_NUM_FLIPDOTTER_LATCH
		depends on DRIVER_FLIPDOTTER_ENABLE
		int "GPIO pin used for latch"
	
	config PIN_NUM_FLIPDOTTER_FIRE
		depends on DRIVER_FLIPDOTTER_ENABLE
		int "GPIO pin used for fire"

	config FLIPDOTTER_COLS
		depends on DRIVER_FLIPDOTTER_ENABLE
		int "Number of columns"
	
	config FLIPDOTTER_ROWS
		depends on DRIVER_FLIPDOTTER_ENABLE
		int "Number of rows"
	
	config FLIPDOTTER_MODULES
		depends on DRIVER_FLIPDOTTER_ENABLE
		int "Number of modules"

	config PIN_NUM_FLIPDOTTER_BACKLIGHT
		depends on DRIVER_FLIPDOTTER_ENABLE
		int "GPIO pin used for backlight"
endmenu
```

## firmware/components/driver_display_generic_i2c/Kconfig
```kconfig
menu "Driver: Generic i2c display"
	config DRIVER_DISPLAY_I2C_ENABLE
		depends on DRIVER_I2C_ENABLE
		bool "Enable the generic i2c display driver"
		default n

	config DISPLAY_I2C_WIDTH
		depends on DRIVER_DISPLAY_I2C_ENABLE
		int "Display width"
		default 4

	config DISPLAY_I2C_HEIGHT
		depends on DRIVER_DISPLAY_I2C_ENABLE
		int "Display height"
		default 4
	
	config DISPLAY_I2C_ADDR
		depends on DRIVER_DISPLAY_I2C_ENABLE
		int "Display framebuffer I2C address"
		default 25

	config DISPLAY_I2C_FRAMEBUF_REG
		depends on DRIVER_DISPLAY_I2C_ENABLE
		int "Display framebuffer register offset"
		default 10

	config DISPLAY_I2C_DIRTYBYTE_REG
		depends on DRIVER_DISPLAY_I2C_ENABLE
		int "Display dirty byte register offset (redraws display)"
		default 58
endmenu
```

## firmware/components/driver_display_gxgde0213b1/Kconfig
```kconfig
menu "Driver: gxgde0213b1 E-ink display"
	config DRIVER_GXGDE0213B1_ENABLE
		depends on DRIVER_VSPI_ENABLE
		bool "Enable the GXGDE0213B1 E-ink display driver"
		default n
	
	config PIN_NUM_GXGDE0213B1_RESET
		depends on DRIVER_GXGDE0213B1_ENABLE
		int "GPIO pin used for RESET"
		
	config PIN_NUM_GXGDE0213B1_BUSY
		depends on DRIVER_GXGDE0213B1_ENABLE
		int "GPIO pin used for BUSY"
	
	config PIN_NUM_GXGDE0213B1_CS
		depends on DRIVER_GXGDE0213B1_ENABLE
		int "GPIO pin used for CS"
	
	config PIN_NUM_GXGDE0213B1_DCX
		depends on DRIVER_GXGDE0213B1_ENABLE
		int "GPIO pin used for D/C"
endmenu
```

## firmware/components/driver_display_hub75/Kconfig
```kconfig
menu "Driver: HUB75 LED panel display"
	config DRIVER_HUB75_ENABLE
		bool "Enable the HUB75 LED driver, used for driving LED panels"
		default n
	
	config PIN_NUM_HUB75_R0
		depends on DRIVER_HUB75_ENABLE
		int "GPIO to use as R0 pin"

	config PIN_NUM_HUB75_G0
		depends on DRIVER_HUB75_ENABLE
		int "GPIO to use as G0 pin"

	config PIN_NUM_HUB75_B0
		depends on DRIVER_HUB75_ENABLE
		int "GPIO to use as B0 pin"

	config PIN_NUM_HUB75_A
		depends on DRIVER_HUB75_ENABLE
		int "GPIO to use as A (row selector) pin"

	config PIN_NUM_HUB75_B
		depends on DRIVER_HUB75_ENABLE
		int "GPIO to use as B (row selector) pin"

	config PIN_NUM_HUB75_C
		depends on DRIVER_HUB75_ENABLE
		int "GPIO to use as C (row selector) pin"

	config PIN_NUM_HUB75_LAT
		depends on DRIVER_HUB75_ENABLE
		int "GPIO to use as LAT (latch) pin"

	config PIN_NUM_HUB75_CLK
		depends on DRIVER_HUB75_ENABLE
		int "GPIO to use as CLK (clock) pin"

	config PIN_NUM_HUB75_OE
		depends on DRIVER_HUB75_ENABLE
		int "GPIO to use as OE (output enable) pin"

	config HUB75_HEIGHT
		depends on DRIVER_HUB75_ENABLE
		int "Number of rows of LED panel (max 8)"
		default 8

	config HUB75_WIDTH
		depends on DRIVER_HUB75_ENABLE
		int "Number of columns of LED panel (unlimited)"
		default 32

	config HUB75_DEFAULT_BRIGHTNESS
		depends on DRIVER_HUB75_ENABLE
		int "Default brightness, being a value between 0 and "
		default 30

	config HUB75_CLOCK_SPEED
		depends on DRIVER_HUB75_ENABLE
		int "Clock speed to run the HUB75 I2S updates at"
		default 2000000

endmenu
```

## firmware/components/driver_display_ili9341/Kconfig
```kconfig
menu "Driver: ILI9341 LCD display"
	config DRIVER_ILI9341_ENABLE
		depends on BUS_VSPI_ENABLE
		bool "Enable the ILI9341 display driver"
		default n
		
	config PIN_NUM_ILI9341_RESET
		depends on DRIVER_ILI9341_ENABLE
		int "GPIO pin used for RESET"
	
	config PIN_NUM_ILI9341_DCX
		depends on DRIVER_ILI9341_ENABLE
		int "GPIO pin used for D/CX"
		
	config PIN_NUM_ILI9341_CS
		depends on DRIVER_ILI9341_ENABLE
		int "GPIO pin used for CS"
	
	config PIN_NUM_ILI9341_BACKLIGHT
		depends on DRIVER_ILI9341_ENABLE
		int "GPIO pin used for backlight"
		
	config DRIVER_ILI9341_SPI_SPEED
		depends on DRIVER_ILI9341_ENABLE
		int "SPI clock speed"
		default 40000000
		range 100000 40000000
	
	config ILI9341_ORIENTATION
		depends on DRIVER_ILI9341_ENABLE
		int "Hardware orientation (0-3)"
		range 0 3
		default 0
	
	config ILI9341_COLOR_SWAP
		depends on DRIVER_ILI9341_ENABLE
		bool "Swap red and blue"
		default n
	
	config DRIVER_ILI9341_8C
		depends on DRIVER_ILI9341_ENABLE
		bool "Reduce color depth to 256 colors"

	config DRIVER_ILI9341_STM32_MCH_BACKLIGHT
		depends on DRIVER_ILI9341_ENABLE && DRIVER_MCH2021_STM32_ENABLE
		bool "Use MCH2022 STM32 for backlight control"
endmenu
```

## firmware/components/driver_display_ledmatrix/Kconfig
```kconfig
menu "Driver: LED matrix"
	config DRIVER_LEDMATRIX_ENABLE
		bool "Enable the LED matrix driver"
		default n
	config DRIVER_LEDMATRIX_PIN_ROW_0
		depends on DRIVER_LEDMATRIX_ENABLE
		int "GPIO used for row 0"
		default -1
		help
			Set to -1 if when not used
	config DRIVER_LEDMATRIX_PIN_ROW_1
		depends on DRIVER_LEDMATRIX_ENABLE && (DRIVER_LEDMATRIX_PIN_ROW_0>=0)
		int "GPIO used for row 1"
		default -1
		help
			Set to -1 if when not used
	config DRIVER_LEDMATRIX_PIN_ROW_2
		depends on DRIVER_LEDMATRIX_ENABLE && (DRIVER_LEDMATRIX_PIN_ROW_1>=0)
		int "GPIO used for row 2"
		default -1
		help
			Set to -1 if when not used
	config DRIVER_LEDMATRIX_PIN_ROW_3
		depends on DRIVER_LEDMATRIX_ENABLE && (DRIVER_LEDMATRIX_PIN_ROW_2>=0)
		int "GPIO used for row 3"
		default -1
		help
			Set to -1 if when not used
	config DRIVER_LEDMATRIX_PIN_ROW_4
		depends on DRIVER_LEDMATRIX_ENABLE && (DRIVER_LEDMATRIX_PIN_ROW_3>=0)
		int "GPIO used for row 4"
		default -1
		help
			Set to -1 if when not used
	config DRIVER_LEDMATRIX_PIN_ROW_5
		depends on DRIVER_LEDMATRIX_ENABLE && (DRIVER_LEDMATRIX_PIN_ROW_4>=0)
		int "GPIO used for row 5"
		default -1
		help
			Set to -1 if when not used
	config DRIVER_LEDMATRIX_PIN_ROW_6
		depends on DRIVER_LEDMATRIX_ENABLE && (DRIVER_LEDMATRIX_PIN_ROW_5>=0)
		int "GPIO used for row 6"
		default -1
		help
			Set to -1 if when not used
	config DRIVER_LEDMATRIX_PIN_ROW_7
		depends on DRIVER_LEDMATRIX_ENABLE && (DRIVER_LEDMATRIX_PIN_ROW_6>=0)
		int "GPIO used for row 7"
		default -1
		help
			Set to -1 if when not used
	config DRIVER_LEDMATRIX_PIN_ROW_8
		depends on DRIVER_LEDMATRIX_ENABLE && (DRIVER_LEDMATRIX_PIN_ROW_7>=0)
		int "GPIO used for row 8"
		default -1
		help
			Set to -1 if when not used
	config DRIVER_LEDMATRIX_PIN_ROW_9
		depends on DRIVER_LEDMATRIX_ENABLE && (DRIVER_LEDMATRIX_PIN_ROW_8>=0)
		int "GPIO used for row 9"
		default -1
		help
			Set to -1 if when not used
	config DRIVER_LEDMATRIX_PIN_ROW_10
		depends on DRIVER_LEDMATRIX_ENABLE && (DRIVER_LEDMATRIX_PIN_ROW_9>=0)
		int "GPIO used for row 10"
		default -1
		help
			Set to -1 if when not used
	config DRIVER_LEDMATRIX_PIN_ROW_11
		depends on DRIVER_LEDMATRIX_ENABLE && (DRIVER_LEDMATRIX_PIN_ROW_10>=0)
		int "GPIO used for row 11"
		default -1
		help
			Set to -1 if when not used
	config DRIVER_LEDMATRIX_PIN_ROW_12
		depends on DRIVER_LEDMATRIX_ENABLE && (DRIVER_LEDMATRIX_PIN_ROW_11>=0)
		int "GPIO used for row 12"
		default -1
		help
			Set to -1 if when not used
	config DRIVER_LEDMATRIX_PIN_ROW_13
		depends on DRIVER_LEDMATRIX_ENABLE && (DRIVER_LEDMATRIX_PIN_ROW_12>=0)
		int "GPIO used for row 13"
		default -1
		help
			Set to -1 if when not used
	config DRIVER_LEDMATRIX_PIN_ROW_14
		depends on DRIVER_LEDMATRIX_ENABLE && (DRIVER_LEDMATRIX_PIN_ROW_13>=0)
		int "GPIO used for row 14"
		default -1
		help
			Set to -1 if when not used
	config DRIVER_LEDMATRIX_PIN_ROW_15
		depends on DRIVER_LEDMATRIX_ENABLE && (DRIVER_LEDMATRIX_PIN_ROW_14>=0)
		int "GPIO used for row 15"
		default -1
		help
			Set to -1 if when not used
	config DRIVER_LEDMATRIX_PIN_COLUMN_0
		depends on DRIVER_LEDMATRIX_ENABLE
		int "GPIO used for column 0"
		default -1
		help
			Set to -1 if when not used
	config DRIVER_LEDMATRIX_PIN_COLUMN_1
		depends on DRIVER_LEDMATRIX_ENABLE && (DRIVER_LEDMATRIX_PIN_COLUMN_0>=0)
		int "GPIO used for column 1"
		default -1
		help
			Set to -1 if when not used
	config DRIVER_LEDMATRIX_PIN_COLUMN_2
		depends on DRIVER_LEDMATRIX_ENABLE && (DRIVER_LEDMATRIX_PIN_COLUMN_1>=0)
		int "GPIO used for column 2"
		default -1
		help
			Set to -1 if when not used
	config DRIVER_LEDMATRIX_PIN_COLUMN_3
		depends on DRIVER_LEDMATRIX_ENABLE && (DRIVER_LEDMATRIX_PIN_COLUMN_2>=0)
		int "GPIO used for column 3"
		default -1
		help
			Set to -1 if when not used
	config DRIVER_LEDMATRIX_PIN_COLUMN_4
		depends on DRIVER_LEDMATRIX_ENABLE && (DRIVER_LEDMATRIX_PIN_COLUMN_3>=0)
		int "GPIO used for column 4"
		default -1
		help
			Set to -1 if when not used
	config DRIVER_LEDMATRIX_PIN_COLUMN_5
		depends on DRIVER_LEDMATRIX_ENABLE && (DRIVER_LEDMATRIX_PIN_COLUMN_4>=0)
		int "GPIO used for column 5"
		default -1
		help
			Set to -1 if when not used
	config DRIVER_LEDMATRIX_PIN_COLUMN_6
		depends on DRIVER_LEDMATRIX_ENABLE && (DRIVER_LEDMATRIX_PIN_COLUMN_5>=0)
		int "GPIO used for column 6"
		default -1
		help
			Set to -1 if when not used
	config DRIVER_LEDMATRIX_PIN_COLUMN_7
		depends on DRIVER_LEDMATRIX_ENABLE && (DRIVER_LEDMATRIX_PIN_COLUMN_6>=0)
		int "GPIO used for column 7"
		default -1
		help
			Set to -1 if when not used
	config DRIVER_LEDMATRIX_PIN_COLUMN_8
		depends on DRIVER_LEDMATRIX_ENABLE && (DRIVER_LEDMATRIX_PIN_COLUMN_7>=0)
		int "GPIO used for column 8"
		default -1
		help
			Set to -1 if when not used
	config DRIVER_LEDMATRIX_PIN_COLUMN_9
		depends on DRIVER_LEDMATRIX_ENABLE && (DRIVER_LEDMATRIX_PIN_COLUMN_8>=0)
		int "GPIO used for column 9"
		default -1
		help
			Set to -1 if when not used
	config DRIVER_LEDMATRIX_PIN_COLUMN_10
		depends on DRIVER_LEDMATRIX_ENABLE && (DRIVER_LEDMATRIX_PIN_COLUMN_9>=0)
		int "GPIO used for column 10"
		default -1
		help
			Set to -1 if when not used
	config DRIVER_LEDMATRIX_PIN_COLUMN_11
		depends on DRIVER_LEDMATRIX_ENABLE && (DRIVER_LEDMATRIX_PIN_COLUMN_10>=0)
		int "GPIO used for column 11"
		default -1
		help
			Set to -1 if when not used
	config DRIVER_LEDMATRIX_PIN_COLUMN_12
		depends on DRIVER_LEDMATRIX_ENABLE && (DRIVER_LEDMATRIX_PIN_COLUMN_11>=0)
		int "GPIO used for column 12"
		default -1
		help
			Set to -1 if when not used
	config DRIVER_LEDMATRIX_PIN_COLUMN_13
		depends on DRIVER_LEDMATRIX_ENABLE && (DRIVER_LEDMATRIX_PIN_COLUMN_12>=0)
		int "GPIO used for column 13"
		default -1
		help
			Set to -1 if when not used
	config DRIVER_LEDMATRIX_PIN_COLUMN_14
		depends on DRIVER_LEDMATRIX_ENABLE && (DRIVER_LEDMATRIX_PIN_COLUMN_13>=0)
		int "GPIO used for column 14"
		default -1
		help
			Set to -1 if when not used
	config DRIVER_LEDMATRIX_PIN_COLUMN_15
		depends on DRIVER_LEDMATRIX_ENABLE && (DRIVER_LEDMATRIX_PIN_COLUMN_14>=0)
		int "GPIO used for column 15"
		default -1
		help
			Set to -1 if when not used
endmenu
```

## firmware/components/driver_display_nokia6100/Kconfig
```kconfig
menu "Driver: Nokia 6100 LCD display"
	config DRIVER_NOKIA6100_ENABLE
		depends on DRIVER_VSPI_ENABLE
		bool "Enable the Nokia 6100 display driver"
		default n
		
	config PIN_NUM_NOKIA6100_RESET
		depends on DRIVER_NOKIA6100_ENABLE
		int "GPIO pin used for RESET"
	
	config PIN_NUM_NOKIA6100_CS
		depends on DRIVER_NOKIA6100_ENABLE
		int "GPIO pin used for CS"
	
	config PIN_NUM_NOKIA6100_BACKLIGHT
		depends on DRIVER_NOKIA6100_ENABLE
		int "GPIO pin used for backlight"
endmenu
```
