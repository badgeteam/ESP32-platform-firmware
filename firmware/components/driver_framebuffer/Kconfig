## firmware/components/driver_framebuffer/Kconfig
```kconfig
menu "Driver: framebuffer support"
	config DRIVER_FRAMEBUFFER_ENABLE
		bool "Enable the framebuffer driver"
		default n
	config DRIVER_FRAMEBUFFER_FLIP
		depends on DRIVER_FRAMEBUFFER_ENABLE
		bool "Flip by 180 degrees"
		default n
	config DRIVER_FRAMEBUFFER_SWAP_R_AND_B
		bool "Swap red and blue"
		default n
	config G_MATRIX_ENABLE
		bool "Enable the matrix stack, allowing for 2D transformations"
		default n
	config MATRIX_STACK_SIZE
		depends on G_MATRIX_ENABLE
		int "Size allocated to the matrix stack by default, you cannot pushMatrix more times than this number"
		# One 2D matrix is 2x3 floats or 24 bytes in total. For 2D contexts, this means 1536 bytes by default.
		# One 3D matrix is 3x4 floats or 48 bytes in total. For 3D contexts, this means 3072 bytes by default.
		default 64
	config G_NEW_TRIANGLE
		depends on G_MATRIX_ENABLE
		bool "Enable triangle drawing"
		default y
	config G_NEW_CIRCLE
		depends on G_NEW_TRIANGLE
		bool "Enable new circle drawing, enables matrix stack for circles and optimises circle drawing"
		default y
	config G_NEW_QUAD
		depends on G_NEW_TRIANGLE
		bool "Enable quad drawing, used also for rectangle drawing"
		default y
	config G_NEW_RECT
		depends on G_NEW_QUAD
		bool "Enable new rectangle drawing, enables matrix stack for rectangles"
		default y
	config G_NEW_TEXT
		depends on G_MATRIX_ENABLE
		bool "Enable new text drawing, enables matrix stack for text but uses more memory when transformed"
		default y
endmenu
```

## firmware/components/driver_fsoverbus/Kconfig
```kconfig
menu "Driver: FS over bus support"
	config DRIVER_FSOVERBUS_ENABLE
		bool "Enable the FS over bus driver"
		default n
	config DRIVER_FSOVERBUS_BACKEND
			int
			default 0 if FSOB_BACKEND_NONE
			default 1 if FSOB_BACKEND_UART
			choice
				prompt "Set internal backend system"
				default FSOB_BACKEND_UART
				help
					Select backend for fsob

				config FSOB_BACKEND_NONE
					bool "None"
				config FSOB_BACKEND_UART
					bool "Uart"
			endchoice
	config DRIVER_FSOVERBUS_NOBACKEND_HELPER
		bool "Enable fsob_receive_bytes"
		default n
		depends on DRIVER_FSOVERBUS_BACKEND = 0
	config DRIVER_FSOVERBUS_NOBACKEND_HELPER_Size
		int "FSOB helper buffer size"
		default 1024
		depends on DRIVER_FSOVERBUS_NOBACKEND_HELPER = y
    config DRIVER_FSOVERBUS_UART_NUM
        int "Uart hardware number"
        default 2
		depends on DRIVER_FSOVERBUS_BACKEND = 1
	config DRIVER_FSOVERBUS_UART_TX
		int "TX pin"
		default 32
		depends on DRIVER_FSOVERBUS_BACKEND = 1
	config DRIVER_FSOVERBUS_UART_RX
		int "RX pin"
		default 35
		depends on DRIVER_FSOVERBUS_BACKEND = 1
	config DRIVER_FSOVERBUS_UART_CTS
		int "CTS pin"
		default 2
		depends on DRIVER_FSOVERBUS_BACKEND = 1
	config DRIVER_FSOVERBUS_UART_BAUD
		int "Baud rate"
		default 256000
		depends on DRIVER_FSOVERBUS_BACKEND = 1
	config DRIVER_FSOVERBUS_UART_BUFFER_SIZE
		int "UART fifo size"
		default 2048
		depends on DRIVER_FSOVERBUS_BACKEND = 1
endmenu
```

## firmware/components/driver_fsoveruart/Kconfig
```kconfig
menu "Driver: FS over uart support"
	config DRIVER_FSOVERUART_ENABLE
		bool "Enable the FS over uart driver"
		default n
    config DRIVER_FSOVERUART_UART_NUM
        int "Uart hardware number"
        default 2
	config DRIVER_FSOVERUART_UART_TX
		int "TX pin"
		default 32
	config DRIVER_FSOVERUART_UART_RX
		int "RX pin"
		default 35
	config DRIVER_FSOVERUART_UART_CTS
		int "CTS pin"
		default 2
	config DRIVER_FSOVERUART_UART_BAUD
		int "Baud rate"
		default 256000
	config DRIVER_FSOVERUART_BUFFER_SIZE
		int "UART fifo size"
		default 2048
endmenu
```

## firmware/components/driver_input_mpr121/Kconfig
```kconfig
menu "Driver: MPR121 touch input"
	config DRIVER_MPR121_ENABLE
		bool "Enable the MPR121 input driver"
		default n
	
	config I2C_ADDR_MPR121
		depends on DRIVER_MPR121_ENABLE
		int "MPR121 I2C address"
		default 90
		
	config PIN_NUM_MPR121_INT
		depends on DRIVER_MPR121_ENABLE
		int "GPIO pin used for MPR121 interrupt"
		
	choice
		prompt "Electrode 0"
		default MPR121_ELE0_NC
		depends on DRIVER_MPR121_ENABLE
	config MPR121_ELE0_NC
		bool "Not connected"
	config MPR121_ELE0_BTN
		bool "Touch input"
	endchoice
	
	choice
		prompt "Electrode 1"
		default MPR121_ELE1_NC
		depends on DRIVER_MPR121_ENABLE
	config MPR121_ELE1_NC
		bool "Not connected"
	config MPR121_ELE1_BTN
		bool "Touch input"
	endchoice
		
	choice
		prompt "Electrode 2"
		default MPR121_ELE2_NC
		depends on DRIVER_MPR121_ENABLE
	config MPR121_ELE2_NC
		bool "Not connected"
	config MPR121_ELE2_BTN
		bool "Touch input"
	endchoice
	
	choice
		prompt "Electrode 3"
		default MPR121_ELE3_NC
		depends on DRIVER_MPR121_ENABLE
	config MPR121_ELE3_NC
		bool "Not connected"
	config MPR121_ELE3_BTN
		bool "Touch input"
	endchoice
	
	choice
		prompt "Electrode 4"
		default MPR121_ELE4_NC
		depends on DRIVER_MPR121_ENABLE
	config MPR121_ELE4_NC
		bool "Not connected"
	config MPR121_ELE4_BTN
		bool "Touch input"
	config MPR121_ELE4_INPUT
		bool "Digital input"
	config MPR121_ELE4_INPUT_PULL_DOWN
		bool "Digital input with pull-down"
	config MPR121_ELE4_INPUT_PULL_UP
		bool "Digital input with pull-up"
	config MPR121_ELE4_OUTPUT
		bool "Digital output"
	config MPR121_ELE4_OUTPUT_LOW_ONLY
		bool "Digital output that only sinks"
	config MPR121_ELE4_OUTPUT_HIGH_ONLY
		bool "Digital output that only sources"
	endchoice
	
	choice
		prompt "Electrode 5"
		default MPR121_ELE5_NC
		depends on DRIVER_MPR121_ENABLE
	config MPR121_ELE5_NC
		bool "Not connected"
	config MPR121_ELE5_BTN
		bool "Touch input"
	config MPR121_ELE5_INPUT
		bool "Digital input"
	config MPR121_ELE5_INPUT_PULL_DOWN
		bool "Digital input with pull-down"
	config MPR121_ELE5_INPUT_PULL_UP
		bool "Digital input with pull-up"
	config MPR121_ELE5_OUTPUT
		bool "Digital output"
	config MPR121_ELE5_OUTPUT_LOW_ONLY
		bool "Digital output that only sinks"
	config MPR121_ELE5_OUTPUT_HIGH_ONLY
		bool "Digital output that only sources"
	endchoice
	
	choice
		prompt "Electrode 6"
		default MPR121_ELE6_NC
		depends on DRIVER_MPR121_ENABLE
	config MPR121_ELE6_NC
		bool "Not connected"
	config MPR121_ELE6_BTN
		bool "Touch input"
	config MPR121_ELE6_INPUT
		bool "Digital input"
	config MPR121_ELE6_INPUT_PULL_DOWN
		bool "Digital input with pull-down"
	config MPR121_ELE6_INPUT_PULL_UP
		bool "Digital input with pull-up"
	config MPR121_ELE6_OUTPUT
		bool "Digital output"
	config MPR121_ELE6_OUTPUT_LOW_ONLY
		bool "Digital output that only sinks"
	config MPR121_ELE6_OUTPUT_HIGH_ONLY
		bool "Digital output that only sources"
	endchoice
	
	choice
		prompt "Electrode 7"
		default MPR121_ELE7_NC
		depends on DRIVER_MPR121_ENABLE
	config MPR121_ELE7_NC
		bool "Not connected"
	config MPR121_ELE7_BTN
		bool "Touch input"
	config MPR121_ELE7_INPUT
		bool "Digital input"
	config MPR121_ELE7_INPUT_PULL_DOWN
		bool "Digital input with pull-down"
	config MPR121_ELE7_INPUT_PULL_UP
		bool "Digital input with pull-up"
	config MPR121_ELE7_OUTPUT
		bool "Digital output"
	config MPR121_ELE7_OUTPUT_LOW_ONLY
		bool "Digital output that only sinks"
	config MPR121_ELE7_OUTPUT_HIGH_ONLY
		bool "Digital output that only sources"
	endchoice
	
	choice
		prompt "Electrode 8"
		default MPR121_ELE8_NC
		depends on DRIVER_MPR121_ENABLE
	config MPR121_ELE8_NC
		bool "Not connected"
	config MPR121_ELE8_BTN
		bool "Touch input"
	config MPR121_ELE8_INPUT
		bool "Digital input"
	config MPR121_ELE8_INPUT_PULL_DOWN
		bool "Digital input with pull-down"
	config MPR121_ELE8_INPUT_PULL_UP
		bool "Digital input with pull-up"
	config MPR121_ELE8_OUTPUT
		bool "Digital output"
	config MPR121_ELE8_OUTPUT_LOW_ONLY
		bool "Digital output that only sinks"
	config MPR121_ELE8_OUTPUT_HIGH_ONLY
		bool "Digital output that only sources"
	endchoice
	
	choice
		prompt "Electrode 9"
		default MPR121_ELE9_NC
		depends on DRIVER_MPR121_ENABLE
	config MPR121_ELE9_NC
		bool "Not connected"
	config MPR121_ELE9_BTN
		bool "Touch input"
	config MPR121_ELE9_INPUT
		bool "Digital input"
	config MPR121_ELE9_INPUT_PULL_DOWN
		bool "Digital input with pull-down"
	config MPR121_ELE9_INPUT_PULL_UP
		bool "Digital input with pull-up"
	config MPR121_ELE9_OUTPUT
		bool "Digital output"
	config MPR121_ELE9_OUTPUT_LOW_ONLY
		bool "Digital output that only sinks"
	config MPR121_ELE9_OUTPUT_HIGH_ONLY
		bool "Digital output that only sources"
	endchoice
	
	choice
		prompt "Electrode 10"
		default MPR121_ELE10_NC
		depends on DRIVER_MPR121_ENABLE
	config MPR121_ELE10_NC
		bool "Not connected"
	config MPR121_ELE10_BTN
		bool "Touch input"
	config MPR121_ELE10_INPUT
		bool "Digital input"
	config MPR121_ELE10_INPUT_PULL_DOWN
		bool "Digital input with pull-down"
	config MPR121_ELE10_INPUT_PULL_UP
		bool "Digital input with pull-up"
	config MPR121_ELE10_OUTPUT
		bool "Digital output"
	config MPR121_ELE10_OUTPUT_LOW_ONLY
		bool "Digital output that only sinks"
	config MPR121_ELE10_OUTPUT_HIGH_ONLY
		bool "Digital output that only sources"
	endchoice
	
	choice
		prompt "Electrode 11"
		default MPR121_ELE11_NC
		depends on DRIVER_MPR121_ENABLE
	config MPR121_ELE11_NC
		bool "Not connected"
	config MPR121_ELE11_BTN
		bool "Touch input"
	config MPR121_ELE11_INPUT
		bool "Digital input"
	config MPR121_ELE11_INPUT_PULL_DOWN
		bool "Digital input with pull-down"
	config MPR121_ELE11_INPUT_PULL_UP
		bool "Digital input with pull-up"
	config MPR121_ELE11_OUTPUT
		bool "Digital output"
	config MPR121_ELE11_OUTPUT_LOW_ONLY
		bool "Digital output that only sinks"
	config MPR121_ELE11_OUTPUT_HIGH_ONLY
		bool "Digital output that only sources"
	endchoice
	
	config MPR121_BASELINE_0
		depends on DRIVER_MPR121_ENABLE
		int "Baseline value for electrode 0"
		default 0
	
	config MPR121_BASELINE_1
		depends on DRIVER_MPR121_ENABLE
		int "Baseline value for electrode 1"
		default 0
	
	config MPR121_BASELINE_2
		depends on DRIVER_MPR121_ENABLE
		int "Baseline value for electrode 2"
		default 0
	
	config MPR121_BASELINE_3
		depends on DRIVER_MPR121_ENABLE
		int "Baseline value for electrode 3"
		default 0
	
	config MPR121_BASELINE_4
		depends on DRIVER_MPR121_ENABLE
		int "Baseline value for electrode 4"
		default 0
	
	config MPR121_BASELINE_5
		depends on DRIVER_MPR121_ENABLE
		int "Baseline value for electrode 5"
		default 0
	
	config MPR121_BASELINE_6
		depends on DRIVER_MPR121_ENABLE
		int "Baseline value for electrode 6"
		default 0
	
	config MPR121_BASELINE_7
		depends on DRIVER_MPR121_ENABLE
		int "Baseline value for electrode 7"
		default 0
	
	config MPR121_BASELINE_8
		depends on DRIVER_MPR121_ENABLE
		int "Baseline value for electrode 8"
		default 0
	
	config MPR121_BASELINE_9
		depends on DRIVER_MPR121_ENABLE
		int "Baseline value for electrode 9"
		default 0
	
	config MPR121_BASELINE_10
		depends on DRIVER_MPR121_ENABLE
		int "Baseline value for electrode 10"
		default 0
	
	config MPR121_BASELINE_11
		depends on DRIVER_MPR121_ENABLE
		int "Baseline value for electrode 11"
		default 0
endmenu
```

## firmware/components/driver_io_disobey_samd/Kconfig
```kconfig
menu "Driver: Disobey 2019 SAMD I/O"
	config DRIVER_DISOBEY_SAMD_ENABLE
		bool "Enable the Disobey 2019 SAMD I/O driver"
		default n

	config I2C_ADDR_DISOBEY_SAMD
		depends on DRIVER_DISOBEY_SAMD_ENABLE
		int "SAMD I2C address"
		default 48

	config PIN_NUM_DISOBEY_SAMD_INT
		depends on DRIVER_DISOBEY_SAMD_ENABLE
		int "GPIO pin used for SAMD interrupt"
		default 25
endmenu
```

## firmware/components/driver_io_hacktivity_samd/Kconfig
```kconfig
menu "Driver: Hacktivity 2019 SAMD I/O"
	config DRIVER_HACKTIVITY_SAMD_ENABLE
		bool "Enable the Hacktivity 2019 SAMD I/O driver"
		default n

	config I2C_ADDR_HACKTIVITY_SAMD
		depends on DRIVER_HACKTIVITY_SAMD_ENABLE
		int "SAMD I2C address"
		default 48

	config PIN_NUM_HACKTIVITY_SAMD_INT
		depends on DRIVER_HACKTIVITY_SAMD_ENABLE
		int "GPIO pin used for SAMD interrupt"
		default 25
endmenu
```

## firmware/components/driver_io_mch2021_stm32/Kconfig
```kconfig
menu "Driver: MCH2022 STM32 co-processor"
	config DRIVER_MCH2021_STM32_ENABLE
		depends on BUS_VSPI_ENABLE
		bool "Enable MCH2021 STM32 driver"
		default n
		
    config DRIVER_MCH2021_STM32_USE_PCA9555_FOR_RESET
        depends on DRIVER_MCH2021_STM32_ENABLE && DRIVER_PCA9555_ENABLE
        bool "Use PCA9555 for RESET pin"
		
	config PIN_NUM_MCH2021_STM32_RESET
		depends on DRIVER_MCH2021_STM32_ENABLE && (!DRIVER_MCH2021_STM32_USE_PCA9555_FOR_RESET)
		int "GPIO pin used for RESET"
		
	config PIN_NUM_MCH2021_STM32_RESET_PCA9555
		depends on DRIVER_MCH2021_STM32_ENABLE && DRIVER_MCH2021_STM32_USE_PCA9555_FOR_RESET
		int "PCA9555 pin used for RESET"
		
    config DRIVER_MCH2021_STM32_USE_PCA9555_FOR_BOOT0
        depends on DRIVER_MCH2021_STM32_ENABLE && DRIVER_PCA9555_ENABLE
        bool "Use PCA9555 for BOOT0 pin"
        
	config PIN_NUM_MCH2021_STM32_BOOT0
		depends on DRIVER_MCH2021_STM32_ENABLE && (!DRIVER_MCH2021_STM32_USE_PCA9555_FOR_BOOT0)
		int "GPIO pin used for BOOT0"
		
	config PIN_NUM_MCH2021_STM32_BOOT0_PCA9555
		depends on DRIVER_MCH2021_STM32_ENABLE && DRIVER_MCH2021_STM32_USE_PCA9555_FOR_BOOT0
		int "PCA9555 pin used for BOOT0"
		
    config PIN_NUM_MCH2021_STM32_INT
		depends on DRIVER_MCH2021_STM32_ENABLE
		int "GPIO pin used for interrupt"
		
	config PIN_NUM_MCH2021_STM32_CS
		depends on DRIVER_MCH2021_STM32_ENABLE
		int "GPIO pin used for CS"
		
	config DRIVER_MCH2021_STM32_SPI_SPEED
		depends on DRIVER_MCH2021_STM32_ENABLE
		int "SPI clock speed"
		default 40000000
		range 100000 40000000
endmenu
```
