## components/driver_display_erc12864/Kconfig
```kconfig
menu "Driver: ERC12864 LCD display"
	config DRIVER_ERC12864_ENABLE
		depends on BUS_I2C0_ENABLE || BUS_I2C1_ENABLE
		bool "Enable the ERC12864 display driver"
		default n
	
	config I2C_ADDR_ERC12864
		depends on DRIVER_ERC12864_ENABLE
		int "ERC12864 I2C address"
		default 56
	
	config DRIVER_ERC12864_I2C_BUS
		depends on DRIVER_ERC12864_ENABLE
		int"ERC12864 I2C bus"
		default 0
		range 0 1
endmenu
```

## components/driver_display_fri3d/Kconfig
```kconfig
menu "Driver: Fri3d camp 2018 badge display"
	config DRIVER_FRI3D_ENABLE
		bool "Enable the FRI3D camp 2018 display driver"
		default n
	
	config PIN_NUM_FRI3D_DAT
		depends on DRIVER_FRI3D_ENABLE
		int "GPIO to use as data pin"

	config PIN_NUM_FRI3D_CLK
		depends on DRIVER_FRI3D_ENABLE
		int "GPIO to use as clock pin"

	config PIN_NUM_FRI3D_LAT
		depends on DRIVER_FRI3D_ENABLE
		int "GPIO to use as latch pin"

	config PIN_NUM_FRI3D_OE
		depends on DRIVER_FRI3D_ENABLE
		int "GPIO to use as output enable pin"
	
endmenu
```

## components/driver_input_mpr121/Kconfig
```kconfig
menu "Driver: MPR121 touch input"
	config DRIVER_MPR121_ENABLE
        depends on BUS_I2C0_ENABLE || BUS_I2C1_ENABLE
		bool "Enable the MPR121 input driver"
		default n
	
	config I2C_ADDR_MPR121
		depends on DRIVER_MPR121_ENABLE
		int "MPR121 I2C address"
		default 90
		
	config DRIVER_MPR121_I2C_BUS
		depends on DRIVER_MPR121_ENABLE
		int"MPR121 I2C bus"
		default 0
		range 0 1
		
	config PIN_NUM_MPR121_INT
		depends on DRIVER_MPR121_ENABLE
		int "GPIO pin used for MPR121 interrupt"

	config DRIVER_MPR121_THRESHOLD_PRESS
		depends on DRIVER_MPR121_ENABLE
		int "Press threshold"
		default 12
	
	config DRIVER_MPR121_THRESHOLD_RELEASE
		depends on DRIVER_MPR121_ENABLE
		int "Release threshold"
		default 6
	
		
	choice
		prompt "Electrode 0"
		default MPR121_ELE0_NC
		depends on DRIVER_MPR121_ENABLE
	config MPR121_ELE0_NC
		bool "Not connected"
	config MPR121_ELE0_BTN
		bool "Touch input"
	endchoice
	
	choice
		prompt "Electrode 1"
		default MPR121_ELE1_NC
		depends on DRIVER_MPR121_ENABLE
	config MPR121_ELE1_NC
		bool "Not connected"
	config MPR121_ELE1_BTN
		bool "Touch input"
	endchoice
		
	choice
		prompt "Electrode 2"
		default MPR121_ELE2_NC
		depends on DRIVER_MPR121_ENABLE
	config MPR121_ELE2_NC
		bool "Not connected"
	config MPR121_ELE2_BTN
		bool "Touch input"
	endchoice
	
	choice
		prompt "Electrode 3"
		default MPR121_ELE3_NC
		depends on DRIVER_MPR121_ENABLE
	config MPR121_ELE3_NC
		bool "Not connected"
	config MPR121_ELE3_BTN
		bool "Touch input"
	endchoice
	
	choice
		prompt "Electrode 4"
		default MPR121_ELE4_NC
		depends on DRIVER_MPR121_ENABLE
	config MPR121_ELE4_NC
		bool "Not connected"
	config MPR121_ELE4_BTN
		bool "Touch input"
	config MPR121_ELE4_INPUT
		bool "Digital input"
	config MPR121_ELE4_INPUT_PULL_DOWN
		bool "Digital input with pull-down"
	config MPR121_ELE4_INPUT_PULL_UP
		bool "Digital input with pull-up"
	config MPR121_ELE4_OUTPUT
		bool "Digital output"
	config MPR121_ELE4_OUTPUT_LOW_ONLY
		bool "Digital output that only sinks"
	config MPR121_ELE4_OUTPUT_HIGH_ONLY
		bool "Digital output that only sources"
	endchoice
	
	choice
		prompt "Electrode 5"
		default MPR121_ELE5_NC
		depends on DRIVER_MPR121_ENABLE
	config MPR121_ELE5_NC
		bool "Not connected"
	config MPR121_ELE5_BTN
		bool "Touch input"
	config MPR121_ELE5_INPUT
		bool "Digital input"
	config MPR121_ELE5_INPUT_PULL_DOWN
		bool "Digital input with pull-down"
	config MPR121_ELE5_INPUT_PULL_UP
		bool "Digital input with pull-up"
	config MPR121_ELE5_OUTPUT
		bool "Digital output"
	config MPR121_ELE5_OUTPUT_LOW_ONLY
		bool "Digital output that only sinks"
	config MPR121_ELE5_OUTPUT_HIGH_ONLY
		bool "Digital output that only sources"
	endchoice
	
	choice
		prompt "Electrode 6"
		default MPR121_ELE6_NC
		depends on DRIVER_MPR121_ENABLE
	config MPR121_ELE6_NC
		bool "Not connected"
	config MPR121_ELE6_BTN
		bool "Touch input"
	config MPR121_ELE6_INPUT
		bool "Digital input"
	config MPR121_ELE6_INPUT_PULL_DOWN
		bool "Digital input with pull-down"
	config MPR121_ELE6_INPUT_PULL_UP
		bool "Digital input with pull-up"
	config MPR121_ELE6_OUTPUT
		bool "Digital output"
	config MPR121_ELE6_OUTPUT_LOW_ONLY
		bool "Digital output that only sinks"
	config MPR121_ELE6_OUTPUT_HIGH_ONLY
		bool "Digital output that only sources"
	endchoice
	
	choice
		prompt "Electrode 7"
		default MPR121_ELE7_NC
		depends on DRIVER_MPR121_ENABLE
	config MPR121_ELE7_NC
		bool "Not connected"
	config MPR121_ELE7_BTN
		bool "Touch input"
	config MPR121_ELE7_INPUT
		bool "Digital input"
	config MPR121_ELE7_INPUT_PULL_DOWN
		bool "Digital input with pull-down"
	config MPR121_ELE7_INPUT_PULL_UP
		bool "Digital input with pull-up"
	config MPR121_ELE7_OUTPUT
		bool "Digital output"
	config MPR121_ELE7_OUTPUT_LOW_ONLY
		bool "Digital output that only sinks"
	config MPR121_ELE7_OUTPUT_HIGH_ONLY
		bool "Digital output that only sources"
	endchoice
	
	choice
		prompt "Electrode 8"
		default MPR121_ELE8_NC
		depends on DRIVER_MPR121_ENABLE
	config MPR121_ELE8_NC
		bool "Not connected"
	config MPR121_ELE8_BTN
		bool "Touch input"
	config MPR121_ELE8_INPUT
		bool "Digital input"
	config MPR121_ELE8_INPUT_PULL_DOWN
		bool "Digital input with pull-down"
	config MPR121_ELE8_INPUT_PULL_UP
		bool "Digital input with pull-up"
	config MPR121_ELE8_OUTPUT
		bool "Digital output"
	config MPR121_ELE8_OUTPUT_LOW_ONLY
		bool "Digital output that only sinks"
	config MPR121_ELE8_OUTPUT_HIGH_ONLY
		bool "Digital output that only sources"
	endchoice
	
	choice
		prompt "Electrode 9"
		default MPR121_ELE9_NC
		depends on DRIVER_MPR121_ENABLE
	config MPR121_ELE9_NC
		bool "Not connected"
	config MPR121_ELE9_BTN
		bool "Touch input"
	config MPR121_ELE9_INPUT
		bool "Digital input"
	config MPR121_ELE9_INPUT_PULL_DOWN
		bool "Digital input with pull-down"
	config MPR121_ELE9_INPUT_PULL_UP
		bool "Digital input with pull-up"
	config MPR121_ELE9_OUTPUT
		bool "Digital output"
	config MPR121_ELE9_OUTPUT_LOW_ONLY
		bool "Digital output that only sinks"
	config MPR121_ELE9_OUTPUT_HIGH_ONLY
		bool "Digital output that only sources"
	endchoice
	
	choice
		prompt "Electrode 10"
		default MPR121_ELE10_NC
		depends on DRIVER_MPR121_ENABLE
	config MPR121_ELE10_NC
		bool "Not connected"
	config MPR121_ELE10_BTN
		bool "Touch input"
	config MPR121_ELE10_INPUT
		bool "Digital input"
	config MPR121_ELE10_INPUT_PULL_DOWN
		bool "Digital input with pull-down"
	config MPR121_ELE10_INPUT_PULL_UP
		bool "Digital input with pull-up"
	config MPR121_ELE10_OUTPUT
		bool "Digital output"
	config MPR121_ELE10_OUTPUT_LOW_ONLY
		bool "Digital output that only sinks"
	config MPR121_ELE10_OUTPUT_HIGH_ONLY
		bool "Digital output that only sources"
	endchoice
	
	choice
		prompt "Electrode 11"
		default MPR121_ELE11_NC
		depends on DRIVER_MPR121_ENABLE
	config MPR121_ELE11_NC
		bool "Not connected"
	config MPR121_ELE11_BTN
		bool "Touch input"
	config MPR121_ELE11_INPUT
		bool "Digital input"
	config MPR121_ELE11_INPUT_PULL_DOWN
		bool "Digital input with pull-down"
	config MPR121_ELE11_INPUT_PULL_UP
		bool "Digital input with pull-up"
	config MPR121_ELE11_OUTPUT
		bool "Digital output"
	config MPR121_ELE11_OUTPUT_LOW_ONLY
		bool "Digital output that only sinks"
	config MPR121_ELE11_OUTPUT_HIGH_ONLY
		bool "Digital output that only sources"
	endchoice

	config MPR121_OUTPUT_DEFAULT_ON_4
		depends on DRIVER_MPR121_ENABLE && (MPR121_ELE4_OUTPUT || MPR121_ELE4_OUTPUT_LOW_ONLY || MPR121_ELE4_OUTPUT_HIGH_ONLY)
		bool "Digital output default to high for electrode electrode 4"
	
	config MPR121_OUTPUT_DEFAULT_ON_5
		depends on DRIVER_MPR121_ENABLE && (MPR121_ELE5_OUTPUT || MPR121_ELE5_OUTPUT_LOW_ONLY || MPR121_ELE5_OUTPUT_HIGH_ONLY)
		bool "Digital output default to high for electrode electrode 5"
	
	config MPR121_OUTPUT_DEFAULT_ON_6
		depends on DRIVER_MPR121_ENABLE && (MPR121_ELE6_OUTPUT || MPR121_ELE6_OUTPUT_LOW_ONLY || MPR121_ELE6_OUTPUT_HIGH_ONLY)
		bool "Digital output default to high for electrode electrode 6"
	
	config MPR121_OUTPUT_DEFAULT_ON_7
		depends on DRIVER_MPR121_ENABLE && (MPR121_ELE7_OUTPUT || MPR121_ELE7_OUTPUT_LOW_ONLY || MPR121_ELE7_OUTPUT_HIGH_ONLY)
		bool "Digital output default to high for electrode electrode 7"
	
	config MPR121_OUTPUT_DEFAULT_ON_8
		depends on DRIVER_MPR121_ENABLE && (MPR121_ELE8_OUTPUT || MPR121_ELE8_OUTPUT_LOW_ONLY || MPR121_ELE8_OUTPUT_HIGH_ONLY)
		bool "Digital output default to high for electrode electrode 8"
	
	config MPR121_OUTPUT_DEFAULT_ON_9
		depends on DRIVER_MPR121_ENABLE && (MPR121_ELE9_OUTPUT || MPR121_ELE9_OUTPUT_LOW_ONLY || MPR121_ELE9_OUTPUT_HIGH_ONLY)
		bool "Digital output default to high for electrode electrode 9"
	
	config MPR121_OUTPUT_DEFAULT_ON_10
		depends on DRIVER_MPR121_ENABLE && (MPR121_ELE10_OUTPUT || MPR121_ELE10_OUTPUT_LOW_ONLY || MPR121_ELE10_OUTPUT_HIGH_ONLY)
		bool "Digital output default to high for electrode electrode 10"
	
	config MPR121_OUTPUT_DEFAULT_ON_11
		depends on DRIVER_MPR121_ENABLE && (MPR121_ELE11_OUTPUT || MPR121_ELE11_OUTPUT_LOW_ONLY || MPR121_ELE11_OUTPUT_HIGH_ONLY)
		bool "Digital output default to high for electrode electrode 11"
endmenu
```

## components/driver_microphone/Kconfig
```kconfig
menu "Driver: microphone"
	config DRIVER_MICROPHONE_ENABLE
		bool "Enable the microphone driver"
		default n
	config DRIVER_MICROPHONE_I2S_NUM
		depends on DRIVER_MICROPHONE_ENABLE
		int "I2S bus"
		default 0
endmenu
```

## components/driver_sdcard/Kconfig
```kconfig
menu "Driver: SD card"
	config DRIVER_SDCARD_ENABLE
		bool "Enable the SD card driver"
		default n

	choice
		depends on DRIVER_SDCARD_ENABLE
		prompt "SD Card mode"
		default DRIVER_SDCARD_MODE_SPI
		help
			Select SD Card operating mode
		config DRIVER_SDCARD_MODE_SPI
			bool "SPI Mode"
		config DRIVER_SDCARD_MODE_1LINE
			bool "1-line SD Mode"
		config DRIVER_SDCARD_MODE_4LINE
			bool "4-line SD Mode"
	endchoice
	
	choice
		depends on DRIVER_SDCARD_ENABLE && DRIVER_SDCARD_MODE_SPI
		prompt "SD Card SPI bus"
		default DRIVER_SDCARD_BUS_HSPI
		help
			Select SD Card SPI bus
		config DRIVER_SDCARD_BUS_HSPI
			bool "HSPI"
		config DRIVER_SDCARD_BUS_VSPI
			bool "VSPI"
	endchoice
	
	config DRIVER_SDCARD_PIN_CLK
		depends on DRIVER_SDCARD_ENABLE && DRIVER_SDCARD_MODE_SPI
		int "CLK pin"
		help
			Pin used as SPI CLK

	config DRIVER_SDCARD_PIN_MOSI
		depends on DRIVER_SDCARD_ENABLE && DRIVER_SDCARD_MODE_SPI
		int "MOSI pin"
		help
			Pin used as SPI MOSI

	config DRIVER_SDCARD_PIN_MISO
		depends on DRIVER_SDCARD_ENABLE && DRIVER_SDCARD_MODE_SPI
		int "MISO pin"
		help
			Pin used as SPI MISO

	config DRIVER_SDCARD_PIN_CS
		depends on DRIVER_SDCARD_ENABLE && DRIVER_SDCARD_MODE_SPI
		int "CS pin"
		help
			Pin used as SPI CS
	
	config DRIVER_SDCARD_DMA_CHANNEL
			int
			depends on DRIVER_SDCARD_ENABLE && DRIVER_SDCARD_MODE_SPI
			default 0 if DRIVER_SDCARD_DMA_NONE
			default 1 if DRIVER_SDCARD_DMA_1
			default 2 if DRIVER_SDCARD_DMA_2
	
	choice
		depends on DRIVER_SDCARD_ENABLE && DRIVER_SDCARD_MODE_SPI
		prompt "SD Card DMA channel"
		default DRIVER_SDCARD_DMA_2
		help
			Select SD Card DMA channel
		config DRIVER_SDCARD_DMA_NONE
			bool "No DMA"
		config DRIVER_SDCARD_DMA_1
			bool "DMA channel 1"
		config DRIVER_SDCARD_DMA_2
			bool "DMA channel 2"
	endchoice
	
	config DRIVER_SDCARD_USE_MPR121_PIN
		depends on DRIVER_SDCARD_ENABLE && DRIVER_MPR121_ENABLE
		bool "Use a GPIO pin of the MPR121 to enable SD card power"
		default n
		help
			Turn on an output on a connected MPR121 I/O expander before mounting the SD card.
		
	config DRIVER_SDCARD_MPR121_PIN
		depends on DRIVER_SDCARD_ENABLE && DRIVER_MPR121_ENABLE && DRIVER_SDCARD_USE_MPR121_PIN
		int "MPR121 pin number"
	
	config DRIVER_SDCARD_FATFS_MAX_FILES
		depends on DRIVER_SDCARD_ENABLE
		int "Maximum number of opened files"
		default 2
endmenu
```

## components/driver_sensor_am2320/Kconfig
```kconfig
menu "Driver: AM2320 I2C temp/hum sensor"
	config DRIVER_AM2320_ENABLE
		depends on DRIVER_I2C_ENABLE
		bool "Enable the AM2320 I2C driver"
		default n		
    config DRIVER_AM2320_I2C_BUS
		depends on DRIVER_AM2320_ENABLE
		int"AM2320 I2C bus"
		default 0
		range 0 1
	config DRIVER_AM2320_I2C_ADDRESS
		depends on DRIVER_AM2320_ENABLE
		hex "I2c address for the AM2320 sensor"
		default 0x5C
endmenu
```

## firmware/components/badge/Kconfig.projbuild
```kconfig
menu "Badge"

    menu "Firmware"
        config BADGE_FIRMWARE_NAME
            string "Firmware version: name"
            default "bleeding edge"
            help
                Name of the firmware

        config BADGE_FIRMWARE_BUILD
            int "Firmware version: build"
            default 0
            help
                Build number of the firmware
    endmenu

    menu "Hardware"
        config BADGE_NAME
            string "Badge name"
            default "Plain ESP32"
            help
                A semantic name for your badge

        config BADGE_FROZEN_MPY_DIR
            string "MicroPython modules directory"
            default "generic"
            help
                The name of the directory in /components/micropython/modules to load into firmware image.
    endmenu

    menu "Drivers"
    endmenu

endmenu
```

## firmware/components/device_info/Kconfig.projbuild
```kconfig
menu "Build configuration"
	menu "Firmware description"
	config INFO_FIRMWARE_NAME
		string "Code-name of the firmware"
		default "Bleeding edge"
	
	config INFO_FIRMWARE_BUILD
		int "Buildnumber of the firmware"
		default 0
		help
                Build number of the firmware
	endmenu
	
	menu "Hardware description"
	config INFO_HARDWARE_NAME
		string "Name of the device"
		default "Generic device"
		help
                A semantic name for your badge

	config INFO_HARDWARE_FOLDER
		string "MicroPython modules directory"
		default "generic"
		help
                The name of the directory in /components/micropython/modules to load into firmware image.
	endmenu
endmenu
```

## firmware/components/driver_board_openaars/Kconfig
```kconfig
menu "Driver: Open AARS FPGA board"
	config DRIVER_OPENAARS_ENABLE
		depends on DRIVER_VSPI_ENABLE
		bool "Enable Open Aars communications"
		default n

  config PIN_NUM_OPENAARS_SCK
    depends on DRIVER_VSPI_ENABLE
    int "GPIO pin used for FPGA SPI clock"
    range 0 39
    default 18

  config PIN_NUM_OPENAARS_MISO
    depends on DRIVER_VSPI_ENABLE
    int "GPIO pin used for FPGA SPI MISO"
    range 0 39
    default 19

  config PIN_NUM_OPENAARS_MOSI
    depends on DRIVER_VSPI_ENABLE
    int "GPIO pin used for FPGA SPI MOSI"
    range 0 39
    default 23
  
  config PIN_NUM_OPENAARS_CS
    depends on DRIVER_VSPI_ENABLE
    int "GPIO pin used for FPGA SPI CS"
    range 0 39
    default 33

  config PIN_NUM_OPENAARS_FPGA_INT
    depends on DRIVER_VSPI_ENABLE
    int "GPIO pin used for FPGA to ESP32 Interrupts"
    range 0 39
    default 25

  config PIN_NUM_OPENAARS_ADV_INT
    depends on DRIVER_VSPI_ENABLE
    int "GPIO pin used for ADV7511 Interrupt events"
    range 0 39
    default 35

  config PIN_NUM_OPENAARS_LED0
    depends on DRIVER_VSPI_ENABLE
    int "GPIO pin used for LED 0"
    range 0 39
    default 21

  config PIN_NUM_OPENAARS_LED1
    depends on DRIVER_VSPI_ENABLE
    int "GPIO pin used for LED 1"
    range 0 39
    default 22
endmenu
```
