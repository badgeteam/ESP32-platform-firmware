## firmware/components/driver_display_ssd1306/Kconfig
```kconfig
menu "Driver: SSD1306 OLED display"
	config DRIVER_SSD1306_ENABLE
		depends on BUS_I2C0_ENABLE || BUS_I2C1_ENABLE
		bool "Enable the SSD1306 display driver"
		default n
	
	config I2C_ADDR_SSD1306
		depends on DRIVER_SSD1306_ENABLE
		int "SSD1306 I2C address"
		default 60
		
	config DRIVER_SSD1306_I2C_BUS
		depends on DRIVER_SSD1306_ENABLE
		int"SSD1306 I2C bus"
		default 0
		range 0 1
	
	config PIN_NUM_SSD1306_RESET
		depends on DRIVER_SSD1306_ENABLE
		int "GPIO pin used for SSD1306 reset"
endmenu
```

## firmware/components/driver_display_st7735/Kconfig
```kconfig
menu "Driver: ST7735 LCD display"
	config DRIVER_ST7735_ENABLE
		depends on DRIVER_VSPI_ENABLE
		bool "Enable the ST7735 display driver"
		default n
		
	config PIN_NUM_ST7735_RESET
		depends on DRIVER_ST7735_ENABLE
		int "GPIO pin used for RESET"
	
	config PIN_NUM_ST7735_DCX
		depends on DRIVER_ST7735_ENABLE
		int "GPIO pin used for D/CX"
		
	config PIN_NUM_ST7735_CS
		depends on DRIVER_ST7735_ENABLE
		int "GPIO pin used for CS"
	
	config PIN_NUM_ST7735_BACKLIGHT
		depends on DRIVER_ST7735_ENABLE
		int "GPIO pin used for backlight"
endmenu
```

## firmware/components/driver_display_st7789v/Kconfig
```kconfig
menu "Driver: ST7789V LCD display"
	config DRIVER_ST7789V_ENABLE
		depends on BUS_VSPI_ENABLE
		bool "Enable the ST7789V display driver"
		default n
		
	config PIN_NUM_ST7789V_RESET
		depends on DRIVER_ST7789V_ENABLE
		int "GPIO pin used for RESET (or -1 for software reset)"
		default -1
	
	config PIN_NUM_ST7789V_DCX
		depends on DRIVER_ST7789V_ENABLE
		int "GPIO pin used for D/CX"
		
	config PIN_NUM_ST7789V_CS
		depends on DRIVER_ST7789V_ENABLE
		int "GPIO pin used for CS"
    
    config DRIVER_ST7789V_SPI_SPEED
        depends on DRIVER_ST7789V_ENABLE
        int "SPI bus speed"
        default 4000000
	
	config PIN_NUM_ST7789V_BACKLIGHT
		depends on DRIVER_ST7789V_ENABLE
		int "GPIO pin used for backlight (or -1)"
		default -1
    
    config DRIVER_ST7789V_BACKLIGHT_AT_BOOT
		depends on DRIVER_ST7789V_ENABLE
		bool "Turn backlight on at boot"
		default y
		
	config DRIVER_ST7789V_BACKLIGHT_INVERT
		depends on DRIVER_ST7789V_ENABLE
		bool "Backlight pin is inverted (active low)"
		default n
	
	config DRIVER_ST7789V_8C
		depends on DRIVER_ST7789V_ENABLE
		bool "Reduce color depth to 256 colors"
    
    config DRIVER_ST7789V_COLOR_INVERT
		depends on DRIVER_ST7789V_ENABLE
		bool "Invert display colors"
		default y
	
	config DRIVER_ST7789V_WIDTH
		depends on DRIVER_ST7789V_ENABLE
		int "Screen width"
		default 320
	
	config DRIVER_ST7789V_HEIGHT
		depends on DRIVER_ST7789V_ENABLE
		int "Screen height"
		default 240
	
	config DRIVER_ST7789V_OFFSET_X
		depends on DRIVER_ST7789V_ENABLE
		int "Screen window offset X"
		default 0
	
	config DRIVER_ST7789V_OFFSET_Y
		depends on DRIVER_ST7789V_ENABLE
		int "Screen window offset Y"
		default 0

	choice
		prompt "Display mode"
		default DRIVER_ST7789V_DD_NORMAL
		depends on DRIVER_ST7789V_ENABLE
	config DRIVER_ST7789V_DD_NORMAL
		bool "Normal"
    config DRIVER_ST7789V_DD_XMIRROR
		bool "Mirror X axis"
    config DRIVER_ST7789V_DD_YMIRROR
		bool "Mirror Y axis"
    config DRIVER_ST7789V_DD_XYMIRROR
		bool "Mirror X and Y axis"
    config DRIVER_ST7789V_DD_XYE
		bool "Exchange X and Y axis"
    config DRIVER_ST7789V_DD_XYEXMIRROR
		bool "Exchange X and Y axis, mirror X axis"
    config DRIVER_ST7789V_DD_XYEYMIRROR
		bool "Exchange X and Y axis, mirror Y axis"
    config DRIVER_ST7789V_DD_XYEXYMIRROR
		bool "Exchange X and Y axis, mirror X and Y axis"
	endchoice
endmenu
```

## firmware/components/driver_fpga_ice40/Kconfig
```kconfig
menu "Driver: ICE40 FPGA"
	config DRIVER_ICE40_ENABLE
		depends on BUS_VSPI_ENABLE
		bool "Enable ICE40 driver"
		default n
		
    config DRIVER_ICE40_USE_PCA9555_FOR_RESET
        depends on DRIVER_ICE40_ENABLE && DRIVER_PCA9555_ENABLE
        bool "Use PCA9555 for RESET pin"
		
	config PIN_NUM_ICE40_RESET
		depends on DRIVER_ICE40_ENABLE && (!DRIVER_ICE40_USE_PCA9555_FOR_RESET)
		int "GPIO pin used for RESET"
		
	config PIN_NUM_ICE40_RESET_PCA9555
		depends on DRIVER_ICE40_ENABLE && DRIVER_ICE40_USE_PCA9555_FOR_RESET
		int "PCA9555 pin used for RESET"
		
    config DRIVER_ICE40_USE_PCA9555_FOR_DONE
        depends on DRIVER_ICE40_ENABLE && DRIVER_PCA9555_ENABLE
        bool "Use PCA9555 for DONE pin"
        
	config PIN_NUM_ICE40_DONE
		depends on DRIVER_ICE40_ENABLE && (!DRIVER_ICE40_USE_PCA9555_FOR_DONE)
		int "GPIO pin used for DONE"
		
	config PIN_NUM_ICE40_DONE_PCA9555
		depends on DRIVER_ICE40_ENABLE && DRIVER_ICE40_USE_PCA9555_FOR_DONE
		int "PCA9555 pin used for DONE"
		
    config PIN_NUM_ICE40_INT
		depends on DRIVER_ICE40_ENABLE
		int "GPIO pin used for interrupt"
		
	config PIN_NUM_ICE40_CS
		depends on DRIVER_ICE40_ENABLE
		int "GPIO pin used for CS"
		
	config DRIVER_ICE40_SPI_SPEED
		depends on DRIVER_ICE40_ENABLE
		int "SPI clock speed for programming"
		default 40000000
		range 100000 40000000

	config DRIVER_ICE40_SPI_SPEED_USER
		depends on DRIVER_ICE40_ENABLE
		int "SPI clock speed for user transactions"
		default 26000000
		range 100000 26000000
endmenu
```
